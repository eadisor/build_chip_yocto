## yocto/meta-custom-chip/conf/bblayers.conf.sample
```bitbake
# LAYER_CONF_VERSION is increased each time build/conf/bblayers.conf
# changes incompatibly
LCONF_VERSION = "6"

BBPATH = "${TOPDIR}"
BBFILES ?= ""

BBLAYERS ?= " \
  ##OEROOT##/../poky/meta \
  ##OEROOT##/../poky/meta-yocto \
  ##OEROOT##/../meta-openembedded/meta-oe \
  ##OEROOT##/../meta-chip \
  ##OEROOT##/../meta-sunxi \
  ##OEROOT##/../meta-custom-chip \
  "	
  
BBLAYERS_NON_REMOVABLE ?= " \
  ##OEROOT##/../poky/meta \
  ##OEROOT##/../poky/meta-yocto \
  "
```

## yocto/meta-custom-chip/conf/layer.conf
```bitbake
# We have a conf and classes directory, add to BBPATH
BBPATH .= ":${LAYERDIR}"

# We have recipes-* directories, add to BBFILES
BBFILES += "${LAYERDIR}/recipes-*/*/*.bb \
	${LAYERDIR}/recipes-*/*/*.bbappend"
 
BBFILE_COLLECTIONS += "meta-custom-chip"
BBFILE_PATTERN_meta-custom-chip := "^${LAYERDIR}/"
BBFILE_PRIORITY_meta-custom-chip = "99"

# This should only be incremented on significant changes that will
# cause compatibility issues with other layers
LAYERVERSION_meta-custom-chip = "1"

LAYERDEPENDS_meta-custom-chip = "core"
```
